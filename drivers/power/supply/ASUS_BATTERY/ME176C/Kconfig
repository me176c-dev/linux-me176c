## drivers/power/supply/ASUS_BATTERY/ME176C/Kconfig
```kconfig
#
#  Battery driver configuration
#

menuconfig ASUS_ME176C_BATTERY
	bool "ASUS ME176C Battery support"
	help
	  Say Y here. This option doesn't affect the kernel.
	  If unsure, say Y.

if ASUS_ME176C_BATTERY

config ASUS_BATTERY_ME176C_CHARGER_BQ24192
	tristate "TI BQ24192/BQ24191/BQ24190 Charger"
        default y
	select POWER_SUPPLY_CHARGER
	depends on I2C
	help
	  BQ24192 is the charger chip for lithium-ion (Li+) batteries
	  in handheld and portable equipment.

	  Say Y here if you know your platform has this chip for charging
	  support.

config ASUS_BATTERY_ME176C_UPI_BATTERY
	tristate "UPI ug31xx"
		default y
	depends on I2C
	help
	  say Y to enable suspport for the ug31

endif
```

## drivers/staging/media/atomisp/pci/Kconfig
```kconfig
#
# Kconfig for ISP driver
#

config VIDEO_ATOMISP
       tristate "Intel Atom Image Signal Processor Driver"
       depends on VIDEO_V4L2 && VIDEO_V4L2_SUBDEV_API
       select VIDEOBUF_VMALLOC
        ---help---
          Say Y here if your platform supports Intel Atom SoC
          camera imaging subsystem.
          To compile this driver as a module, choose M here: the
          module will be called atomisp

if VIDEO_ATOMISP
config VIDEO_ATOMISP_TRACE_PRINTK
       bool "Use trace_printk() for debugging"
endif # VIDEO_ATOMISP
```

## modules/camera/drivers/media/i2c/gc0339/Kconfig
```kconfig
config VIDEO_GC0339
	tristate "gc0339 sensor support"
	depends on VIDEO_V4L2 && I2C
	---help---
	  This is a V4L2 camera driver for the OmniVision GC0339 sensor
```

## modules/camera/drivers/media/i2c/gc2155_raw/Kconfig
```kconfig
config VIDEO_GC2155_RAW
	tristate "gc2155 sensor support"
	depends on VIDEO_V4L2 && I2C
	---help---
	  This is a V4L2 camera driver for the OmniVision GC2155 sensor
```

## modules/camera/drivers/media/i2c/hm2056/Kconfig
```kconfig
config VIDEO_HM2056
	tristate "hm2056 sensor support"
	depends on VIDEO_V4L2 && I2C
	---help---
	  This is a V4L2 camera driver for the OmniVision HM2056 sensor
```

## modules/camera/drivers/media/i2c/i2c_seqops/Kconfig
```kconfig
config I2C_SEQOPS
	def_bool y
	depends on I2C
	---help---
	  This lib will load the I2C sequence operations from firmware binary file and provide a convenient way to use them.
```
